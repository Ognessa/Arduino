//Тут можна ознайомитись з особливостями бібліотеки
//http://developer.alexanderklimov.ru/arduino/keypad.php
//Тут є схема самої клавіатури і багато іншої інформації про неї
//https://3d-diy.ru/wiki/arduino-moduli/elastichnaya-matrichnaya-klaviatura-4x4/
 
#include <Keypad.h>
 
char key; //Оголошуємо змінну, яка відповідає за збереження значення натиснутої кнопки
char myarraw[5] = { '1', '2', '3', '4', '5'}; //Створюємо масив з паролем (змінні в лапках, бо тип "char")
char button_pressed[5]; //Створюємно не наповнений значеннями масив фіксованого розміру, який буде зберігати введений код
 
int k=0;  //Оголошуємо змінну-лічільник типу "int", яка буде зберігати кількість введених символів
int s=0;  //Оголошуємо змінну-лічільник типу "int", яка буде зберігати кількість співпавших символів (введений код і пароль)
 
//Необхідно для бібліотеки
//===========================================================================================
const byte ROWS = 4; //Оголошуємо кількість рядків клавіатури
const byte COLS = 4; //Оголошуємо кількість стовпців клавіатури
 
//Створюємо "карту" символів
char keys[ROWS][COLS] = { 
    {'1','2','3','A'},
    {'4','5','6','B'},
    {'7','8','9','C'},
    {'*','0','#','D'}};
 
byte rowPins[ROWS] = {9, 8, 7, 6}; //Вказуємо піни, які відповідають за рядки
byte colPins[COLS] = {5, 4, 3, 2}; //Вказуємо піни, які відповідають за стовпці
Keypad keypad = Keypad( makeKeymap(keys), rowPins, colPins, ROWS, COLS ); //Ініціалізуємо об'єкт класу "Keypad", який називаємо "Keypad" (для зручності використання)
 
void setup() {
    //Проводимо налаштування пінів
    pinMode(10, OUTPUT);
    pinMode(11, INPUT);
}
 
void loop (){ 
    key = keypad.getKey(); //Заносимо метод (getKey) об'єкта Keypad в змінну "key" (метод довзволяє отримати значення натиснутої кнопки)
    //Виконуємо наступні умови тільки якщо кнопка була натиснута
    if ( key != NO_KEY ) {
        //Додаємо значення натиснутої кнопки в масив введеного паролю на місце "k"
        button_pressed [k] = key;
        //Збільшуємо "k" на 1 щоб введений символ не перезаписувався на місце минулого
        k=k+1;
        //Тут обнуляємо змінну "k" якщо було натиснуто * (це треба щоб скинути пароль і почати вводити заново, якщо помились)
        if (key=='*'){
            k=0;}
        //Якщо було введено 5 символів, то починаємо перевірку пароля
        if(k == 5){
          //Цикл, який перевіряє, чи правильно введено код і збільшує змінну співпадінь
          for ( uint8_t i = 0; i < 5; i++){
              //Якщо символ в 2 масивах (пароль і введений код) співпадає - збільшити змінну співпадінь на 1
              if (button_pressed[i] == myarraw[i]){
                  s=s+1;}
            }
        }
    }
    //Тут ми перевіряємо код на правильність введеня (неправильно - обнуляємо змінні, які за пароль відповідають щоб вводити пароль заново)
    if (k==5 and s!=5){
        s=0;k=0;}
    //Блок перевірки 8 умов (всі можливі комбінації станів елементів)
    //(Наприклад перша умова - код не введено, "двері" відкриті, пищалка не пищить, тоді вмикаємо пищалку)
    //далі по аналогії
    if(s!=5 and digitalRead(10)==0 and digitalRead(11)==0){
        digitalWrite(10, 1);}
    else if(s!=5 and digitalRead(10)==0 and digitalRead(11)==1){
        digitalWrite(10, 0);}
    else if(s!=5 and digitalRead(10)==1 and digitalRead(11)==0){
        digitalWrite(10, 1);}
    else if(s!=5 and digitalRead(10)==1 and digitalRead(11)==1){
        digitalWrite(10, 1);}
    else if(s==5 and digitalRead(10)==0 and digitalRead(11)==0){
        digitalWrite(10, 0); s=0;}
    else if(s==5 and digitalRead(10)==0 and digitalRead(11)==1){
        digitalWrite(10, 0); s=0;}
    else if(s==5 and digitalRead(10)==1 and digitalRead(11)==0){
        digitalWrite(10, 1); s=0;}
    else if(s==5 and digitalRead(10)==1 and digitalRead(11)==1){
        digitalWrite(10, 0); s=0;}}
